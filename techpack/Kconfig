## techpack/Kconfig
```kconfig
menu "Techpack Drivers"

source "techpack/datarmnet/core/Kconfig"

source "techpack/datarmnet-ext/aps/Kconfig"

source "techpack/datarmnet-ext/offload/Kconfig"

source "techpack/datarmnet-ext/perf/Kconfig"

source "techpack/datarmnet-ext/perf_tether/Kconfig"

source "techpack/datarmnet-ext/sch/Kconfig"

source "techpack/datarmnet-ext/shs/Kconfig"

source "techpack/datarmnet-ext/wlan/Kconfig"

endmenu
```

## techpack/datarmnet-ext/aps/Kconfig
```kconfig
#
# RMNET_APS drivers
#

config RMNET_APS
    tristate "Rmnet APS support"
    default m
    help
        Apps prioritization module for RmNet driver
```

## techpack/datarmnet-ext/offload/Kconfig
```kconfig
#
# RMNET_OFFLOAD driver
#

config RMNET_OFFLOAD
    tristate "Rmnet offload support"
    default m
    depends on RMNET_CORE
    help
        Offload support for the RmNet driver
```

## techpack/datarmnet-ext/perf/Kconfig
```kconfig
#
# RMNET_PERF driver
#

menuconfig RMNET_PERF
    tristate "Rmnet perf support"
    default m
    depends on RMNET_CORE
    depends on RMNET_SHS
    ---help---
        Performance support for the RmNet driver
```

## techpack/datarmnet-ext/perf_tether/Kconfig
```kconfig
#
# RMNET_PERF_TETHER driver
#

menuconfig RMNET_PERF_TETHER
    tristate "Rmnet perf tethering support"
    default m
    depends on RMNET_CORE
    ---help---
        Offload support for the RmNet driver
```

## techpack/datarmnet-ext/sch/Kconfig
```kconfig
#
# RMNET_SCH driver
#

menuconfig RMNET_SCH
    tristate "Rmnet SCH Qdisc support"
    default m
    ---help---
        QDisc module for RmNet driver
```

## techpack/datarmnet-ext/shs/Kconfig
```kconfig
#
# RMNET_SHS driver
#

config RMNET_SHS
    tristate "Rmnet SHS driver"
    default m
    depends on RMNET_CORE
    help
        performance mode of rmnet driver
```

## techpack/datarmnet-ext/wlan/Kconfig
```kconfig
#
# RMNET_WLAN driver
#

config RMNET_WLAN
    tristate "Rmnet WLAN support"
    default m
    help
        WLAN processing module for RmNet driver
```

## techpack/datarmnet/core/Kconfig
```kconfig
#
# RMNET MAP driver
#

config RMNET_CORE
	tristate "RMNET Core"
	default m 
	select GRO_CELLS
	help
	  If you select this, you will enable the RMNET module which is used
	  for handling data in the multiplexing and aggregation protocol (MAP)
	  format in the embedded data path. RMNET devices can be attached to
	  any IP mode physical device.

config RMNET_CTL
	tristate "RMNET CTL"
	default m
	help
	  Enable the RMNET CTL module which is used for handling QMAP commands
	  for flow control purposes.
```

## wlan/Kconfig
```kconfig
#
# RMNET_WLAN driver
#

menuconfig RMNET_WLAN
    tristate "Rmnet WLAN support"
    default m
    ---help---
        WLAN processing module for RmNet driver
```
