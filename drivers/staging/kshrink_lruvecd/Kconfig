## drivers/staging/kshrink_lruvecd/Kconfig
```kconfig
config KSHRINK_LRUVECD
       tristate "Allow asynchronous shrink lruvec"
       default n
       depends on !LRU_GEN
       help
         Asynchronous shrink lruvec optimization feature
```
