## configs/genoa.snoc.perf_defconfig
```kconfig
# Protocol specific features
CONFIG_QCACLD_WLAN_LFR2 := y
CONFIG_QCACLD_WLAN_LFR3 := n
CONFIG_QCOM_TDLS := y
CONFIG_QCACLD_FEATURE_GREEN_AP := y
CONFIG_QCOM_VOWIFI_11R := y
CONFIG_WLAN_FEATURE_FILS := y
CONFIG_WLAN_FEATURE_11W := y
CONFIG_QCOM_LTE_COEX := y
CONFIG_WLAN_FEATURE_LPSS := y
CONFIG_QCACLD_FEATURE_NAN := y
CONFIG_WLAN_FEATURE_NAN_DATAPATH := y
CONFIG_NAN_CONVERGENCE := y
CONFIG_POWER_MANAGEMENT_OFFLOAD := y
CONFIG_LFR_SUBNET_DETECTION := y
CONFIG_MCC_TO_SCC_SWITCH := y
CONFIG_QCOM_ESE := y
CONFIG_QCA_IBSS_SUPPORT := y
CONFIG_WLAN_OPEN_P2P_INTERFACE := y
CONFIG_WLAN_ENABLE_SOCIAL_CHANNELS_5G_ONLY := y
CONFIG_WLAN_DFS_MASTER_ENABLE := y
CONFIG_WIFI_POS_CONVERGED := y
CONFIG_WIFI_POS_LEGACY := n
CONFIG_FEATURE_WLAN_WAPI := y
CONFIG_AGEIE_ON_SCAN_RESULTS := y
CONFIG_LEGACY_CHAN_ENUM := y
CONFIG_NAPIER_SCAN := y
CONFIG_WLAN_PMO_ENABLE := y
CONFIG_CONVERGED_P2P_ENABLE := y
CONFIG_WLAN_POLICY_MGR_ENABLE := y
CONFIG_SUPPORT_11AX := y
CONFIG_HDD_INIT_WITH_RTNL_LOCK := y
CONFIG_CONVERGED_TDLS_ENABLE := y
CONFIG_WLAN_CONV_SPECTRAL_ENABLE := y
CONFIG_WLAN_SPECTRAL_ENABLE := y
CONFIG_WMI_CMD_STRINGS := y
CONFIG_SOFTAP_CHANNEL_RANGE := y
CONFIG_FEATURE_WLAN_SCAN_PNO := y

# Interface specific features
CONFIG_ROME_IF = snoc
CONFIG_HELIUMPLUS := y
CONFIG_64BIT_PADDR := y
CONFIG_QMI_SUPPORT := y
CONFIG_WIFI_3_0_ADRASTEA := y
CONFIG_ADRASTEA_RRI_ON_DDR := y
CONFIG_ATH_PROCFS_DIAG_SUPPORT := y
CONFIG_ADRASTEA_SHADOW_REGISTERS := y
CONFIG_HTT_PADDR64 := y
CONFIG_AR900B := y
CONFIG_HIF_SNOC:= y

# Data Path specific features
CONFIG_WLAN_FASTPATH := y
CONFIG_FEATURE_TSO := y
CONFIG_WLAN_NAPI := y
CONFIG_WLAN_TX_FLOW_CONTROL_V2 := y
CONFIG_ATH_11AC_TXCOMPACT := y
CONFIG_TX_CREDIT_RECLAIM_SUPPORT := n
CONFIG_CHECKSUM_OFFLOAD := y
CONFIG_QCA_SUPPORT_TX_THROTTLE := y
CONFIG_RX_OL := y
CONFIG_FEATURE_MONITOR_MODE_SUPPORT := n
CONFIG_DESC_DUP_DETECT_DEBUG := n
CONFIG_DEBUG_RX_RING_BUFFER := n
CONFIG_DP_TRACE := y

ifeq ($(CONFIG_INET_LRO), y)
CONFIG_WLAN_LRO := y
else
CONFIG_WLAN_LRO := n
endif

ifeq ($(CONFIG_IPA), y)
CONFIG_IPA_OFFLOAD := y
endif
ifeq ($(CONFIG_IPA3), y)
CONFIG_IPA_OFFLOAD := y
endif

ifneq ($(CONFIG_FORCE_ALLOC_FROM_DMA_ZONE), y)
CONFIG_ENABLE_DEBUG_ADDRESS_MARKING := y
endif

# Debug specific features
BUILD_DEBUG_VERSION := y
BUILD_DIAG_VERSION := y
CONFIG_FEATURE_TSO_DEBUG := n
CONFIG_MPC_UT_FRAMEWORK := n
CONFIG_FEATURE_EPPING := n
CONFIG_WLAN_NAPI_DEBUG := n
CONFIG_REMOVE_PKT_LOG := n
CONFIG_FEATURE_STATS_EXT := y
CONFIG_FEATURE_HTC_CREDIT_HISTORY := y
CONFIG_TRACE_RECORD_FEATURE := y
CONFIG_WLAN_FEATURE_P2P_DEBUG := n
CONFIG_WLAN_NUD_TRACKING := n
CONFIG_CP_STATS := n
CONFIG_FEATURE_FW_LOG_PARSING := y
CONFIG_PTT_SOCK_SVC_ENABLE := y
CONFIG_WMI_INTERFACE_EVENT_LOGGING := y
CONFIG_WLAN_FEATURE_LINK_LAYER_STATS := y
CONFIG_DP_TRACE := y

CONFIG_WLAN_LOG_FATAL := y
CONFIG_WLAN_LOG_ERROR := y
CONFIG_WLAN_LOG_WARN := y
CONFIG_WLAN_LOG_INFO := y
CONFIG_WLAN_LOG_DEBUG := y

ifeq ($(CONFIG_REMOVE_PKT_LOG), y)
CONFIG_WDI_EVENT_ENABLE := n
else
CONFIG_WDI_EVENT_ENABLE := y
endif

# Features gets enabled on slub debug
CONFIG_WLAN_OBJMGR_DEBUG:= n
CONFIG_OL_RX_INDICATION_RECORD := n
CONFIG_TSOSEG_DEBUG := n
CONFIG_FEATURE_PKTLOG := n
CONFIG_WLAN_DEBUG_CRASH_INJECT := n
PANIC_ON_BUG := y
WLAN_WARN_ON_ASSERT := y
CONFIG_FEATURE_MEMDUMP_ENABLE := n
CONFIG_WLAN_LOGGING_SOCK_SVC := n
CONFIG_FEATURE_UNIT_TEST_SUSPEND := n
CONFIG_LEAK_DETECTION := n

ifeq ($(CONFIG_DEBUG_FS), y)
       CONFIG_WLAN_DEBUGFS := n
       CONFIG_WLAN_POWER_DEBUGFS := n
endif

# other features
WLAN_OPEN_SOURCE := y
CONFIG_ATH_PERF_PWR_OFFLOAD := y
CONFIG_ATH_BUS_PM := y
CONFIG_ATH_SUPPORT_FLOWMAC_MODULE := n
CONFIG_ATH_SUPPORT_SPECTRAL := n
CONFIG_LITTLE_ENDIAN := y
CONFIG_QCA_WIFI_FTM := y
CONFIG_ATH_PCIE_ACCESS_DEBUG := n
CONFIG_QCA_SIGNED_SPLIT_BINARY_SUPPORT := n
CONFIG_QCA_SINGLE_BINARY_SUPPORT := n
CONFIG_TARGET_RAMDUMP_AFTER_KERNEL_PANIC := y
CONFIG_FEATURE_SECURE_FIRMWARE := n
CONFIG_WLAN_FEATURE_PACKET_FILTERING := y
CONFIG_WLAN_NS_OFFLOAD := y
CONFIG_FEATURE_WLAN_RA_FILTERING:= y
CONFIG_FEATURE_WLAN_LPHB := y
CONFIG_FEATURE_WLAN_EXTSCAN := y
CONFIG_160MHZ_SUPPORT := y
CONFIG_MCL := y
CONFIG_MCL_REGDB := y
CONFIG_WLAN_OFFLOAD_PACKETS := y
CONFIG_WLAN_SYNC_TSF := y
CONFIG_WLAN_FEATURE_DISA := y
CONFIG_WLAN_FEATURE_FIPS := y
CONFIG_WLAN_FEATURE_SAE := y
CONFIG_GTK_OFFLOAD := y

ifneq ($(DEVELOPER_DISABLE_BUILD_TIMESTAMP), y)
ifneq ($(WLAN_DISABLE_BUILD_TAG), y)
CONFIG_BUILD_TAG := y
endif
endif

ifeq ($(CONFIG_ARCH_SDM845), y)
ifeq ($(CONFIG_IPA_OFFLOAD), y)
CONFIG_ENABLE_SMMU_S1_TRANSLATION := y
endif
endif

CONFIG_ENABLE_SIZE_OPTIMIZE := y

# configure log buffer size
CONFIG_CFG_NUM_DP_TRACE_RECORD := 1000
CONFIG_CFG_NUM_HTC_CREDIT_HISTORY := 16
CONFIG_CFG_NUM_WMI_EVENT_HISTORY := 16
CONFIG_CFG_NUM_WMI_MGMT_EVENT_HISTORY := 16
CONFIG_CFG_NUM_TX_RX_HISTOGRAM := 16
CONFIG_CFG_NUM_RX_IND_RECORD := 1024


###################################
```

## configs/genoa.usb.debug_defconfig
```kconfig
include $(WLAN_ROOT)/configs/genoa.common

# Interface specific features
CONFIG_ROME_IF := usb
CONFIG_HIF_USB := y
CONFIG_LINUX_QCMBR := y
CONFIG_PLD_USB_CNSS := y

# Data Path specific features
CONFIG_ATH_11AC_TXCOMPACT := n
CONFIG_QCA_HL_NETDEV_FLOW_CONTROL := y
CONFIG_FEATURE_HL_GROUP_CREDIT_FLOW_CONTROL := y
CONFIG_FEATURE_HL_DBS_GROUP_CREDIT_SHARING := y
CONFIG_CREDIT_REP_THROUGH_CREDIT_UPDATE := y

# Debug specific features
CONFIG_MPC_UT_FRAMEWORK := y
CONFIG_FEATURE_EPPING := y
CONFIG_WLAN_FEATURE_P2P_DEBUG := y

# Features gets enabled on slub debug
CONFIG_FEATURE_PKTLOG := y
CONFIG_WLAN_DEBUG_CRASH_INJECT := y
CONFIG_FEATURE_MEMDUMP_ENABLE := y

ifeq ($(CONFIG_SLUB_DEBUG_ON), y)
CONFIG_WLAN_OBJMGR_DEBUG:= y
CONFIG_FEATURE_UNIT_TEST_SUSPEND := y
CONFIG_LEAK_DETECTION := y
endif
###################################
```

## configs/kiwi_defconfig
```kconfig
CONFIG_CNSS_KIWI := y

include $(WLAN_ROOT)/configs/default_defconfig

#Enable 11BE EHT
CONFIG_WLAN_FEATURE_11BE := y

# Max Sta Vdev Config
CONFIG_CFG_MAX_STA_VDEVS := 4

#Enable 11BE MLO
CONFIG_WLAN_FEATURE_11BE_MLO := y

CONFIG_WLAN_FEATURE_DYNAMIC_MAC_ADDR_UPDATE := y

#BMISS offload max vdev config
CONFIG_CFG_BMISS_OFFLOAD_MAX_VDEV := 4
```

## configs/kiwi_v2_defconfig
```kconfig
CONFIG_CNSS_KIWI := y
CONFIG_CNSS_KIWI_V2 := y

include $(WLAN_ROOT)/configs/default_defconfig

#Enable 11BE EHT
CONFIG_WLAN_FEATURE_11BE := y

# Max Sta Vdev Config
CONFIG_CFG_MAX_STA_VDEVS := 4

#Enable 11BE MLO
CONFIG_WLAN_FEATURE_11BE_MLO := y

#BMISS offload max vdev config
CONFIG_CFG_BMISS_OFFLOAD_MAX_VDEV := 4

#Chip version
CONFIG_CHIP_VERSION := 2

#DP configs
CONFIG_WLAN_DP_DISABLE_TCL_CMD_CRED_SRNG := y
CONFIG_WLAN_DP_DISABLE_TCL_STATUS_SRNG := y
```

## configs/monaco_consolidate_wlan_defconfig
```kconfig
CONFIG_DESC_TIMESTAMP_DEBUG_INFO=y
CONFIG_DSC_DEBUG=y
CONFIG_UNIT_TEST=y
CONFIG_DSC_TEST=y
CONFIG_ENABLE_QDF_PTR_HASH_DEBUG=y
CONFIG_FEATURE_UNIT_TEST_SUSPEND=y
CONFIG_LEAK_DETECTION=y
CONFIG_MAX_LOGS_PER_SEC=500
CONFIG_ENABLE_MAX_LOGS_PER_SEC=y
CONFIG_REGISTER_OP_DEBUG=y
CONFIG_SCHED_HISTORY_SIZE=256
CONFIG_ENABLE_SCHED_HISTORY_SIZE=y
CONFIG_TALLOC_DEBUG=y
CONFIG_QDF_TEST=y
CONFIG_FEATURE_WLM_STATS=y
CONFIG_WLAN_FEATURE_GET_USABLE_CHAN_LIST=y
```

## configs/parrot_consolidate_qca6750_defconfig
```kconfig
CONFIG_ALLOW_PKT_DROPPING=y
CONFIG_ATH_DIAG_EXT_DIRECT=y
CONFIG_DESC_TIMESTAMP_DEBUG_INFO=y
CONFIG_DSC_DEBUG=y
CONFIG_DSC_TEST=y
CONFIG_FEATURE_UNIT_TEST_SUSPEND=y
CONFIG_HAL_DEBUG=y
CONFIG_LEAK_DETECTION=y
CONFIG_MAX_LOGS_PER_SEC=500
CONFIG_ENABLE_MAX_LOGS_PER_SEC=y
CONFIG_SCHED_HISTORY_SIZE=256
CONFIG_REGISTER_OP_DEBUG=y
CONFIG_RX_DESC_DEBUG_CHECK=y
CONFIG_TALLOC_DEBUG=y
CONFIG_UNIT_TEST=y
CONFIG_QDF_TEST=y
CONFIG_DP_FT_LOCK_HISTORY=y
CONFIG_FEATURE_WLM_STATS=y
```

## configs/parrot_gki_adrastea_defconfig
```kconfig
CONFIG_HANDLE_RX_REROUTE_ERR=y
CONFIG_ICNSS2_MODULE=y
CONFIG_CNSS_GENL_MODULE=y
CONFIG_CNSS_UTILS_MODULE=y
CONFIG_WCNSS_MEM_PRE_ALLOC_MODULE=y
CONFIG_ICNSS2_HELIUM=y
CONFIG_PLD_SNOC_ICNSS_FLAG=y
CONFIG_WLAN_OPEN_SOURCE=y
CONFIG_BUILD_TAG=y
CONFIG_WLAN_FEATURE_MBSSID=y
CONFIG_WLAN_FEATURE_P2P_P2P_STA=y
CONFIG_QCACLD_WLAN_LFR3=y
CONFIG_QCOM_TDLS=y
CONFIG_WLAN_SYSFS=y
CONFIG_THERMAL_STATS_SUPPORT=y
CONFIG_WLAN_SYSFS_STA_INFO=y
CONFIG_WLAN_SYSFS_CHANNEL=y
CONFIG_WLAN_SYSFS_FW_MODE_CFG=y
CONFIG_WLAN_SYSFS_MEM_STATS=y
CONFIG_WLAN_REASSOC=y
CONFIG_WLAN_SYSFS_CONNECT_INFO=y
CONFIG_WLAN_SCAN_DISABLE=y
CONFIG_WLAN_SYSFS_DCM=y
CONFIG_WLAN_WOW_ITO=y
CONFIG_WLAN_WOWL_ADD_PTRN=y
CONFIG_WLAN_WOWL_DEL_PTRN=y
CONFIG_WLAN_SYSFS_TX_STBC=y
CONFIG_WLAN_SYSFS_WLAN_DBG=y
CONFIG_WLAN_TXRX_FW_ST_RST=y
CONFIG_WLAN_GTX_BW_MASK=y
CONFIG_WLAN_SYSFS_SCAN_CFG=y
CONFIG_WLAN_SYSFS_MONITOR_MODE_CHANNEL=y
CONFIG_WLAN_SYSFS_RADAR=y
CONFIG_WLAN_SYSFS_RTS_CTS=y
CONFIG_WLAN_SYSFS_HE_BSS_COLOR=y
CONFIG_WLAN_TXRX_FW_STATS=y
CONFIG_WLAN_TXRX_STATS=y
CONFIG_WLAN_SYSFS_DP_TRACE=y
CONFIG_WLAN_SYSFS_STATS=y
CONFIG_WLAN_SYSFS_TDLS_PEERS=y
CONFIG_WLAN_SYSFS_TEMPERATURE=y
CONFIG_WLAN_THERMAL_CFG=y
CONFIG_WLAN_DL_MODES=y
CONFIG_WLAN_BMISS=y
CONFIG_WLAN_FREQ_LIST=y
CONFIG_DP_PKT_ADD_TIMESTAMP=y
CONFIG_WLAN_POWER_DEBUG=y
CONFIG_FEATURE_BECN_STATS=y
CONFIG_WLAN_FEATURE_MEDIUM_ASSESS=y
CONFIG_QCACLD_FEATURE_GREEN_AP=y
CONFIG_QCACLD_FEATURE_APF=y
CONFIG_QCACLD_FEATURE_FW_STATE=y
CONFIG_QCOM_VOWIFI_11R=y
CONFIG_WLAN_FEATURE_ACTION_OUI=y
CONFIG_ADAPTIVE_11R=y
CONFIG_SAE_SINGLE_PMK=y
CONFIG_MULTI_CLIENT_LL_SUPPORT=y
CONFIG_FEATURE_MSCS=y
CONFIG_WLAN_FEATURE_FILS=y
CONFIG_QCACLD_FEATURE_NAN=y
CONFIG_FEATURE_EPPING=y
CONFIG_WLAN_OFFLOAD_PACKETS=y
CONFIG_WLAN_SYNC_TSF=y
CONFIG_WLAN_FEATURE_SAE=y
CONFIG_WLAN_FEATURE_DISA=y
CONFIG_WLAN_FEATURE_FIPS=y
CONFIG_WLAN_NAPI=y
CONFIG_WLAN_TX_FLOW_CONTROL_V2=y
CONFIG_POWER_MANAGEMENT_OFFLOAD=y
CONFIG_LFR_SUBNET_DETECTION=y
CONFIG_MCC_TO_SCC_SWITCH=y
CONFIG_WLAN_OBJMGR_DEBUG=y
CONFIG_LOCK_STATS_ON=y
CONFIG_WLAN_OBJMGR_REF_ID_TRACE=y
CONFIG_WLAN_SYSFS_RANGE_EXT=y
CONFIG_LL_DP_SUPPORT=y
CONFIG_QMI_SUPPORT=y
CONFIG_WIFI_3_0_ADRASTEA=y
CONFIG_ADRASTEA_RRI_ON_DDR=y
CONFIG_ATH_PROCFS_DIAG_SUPPORT=y
CONFIG_ATH_11AC_TXCOMPACT=y
CONFIG_ADRASTEA_SHADOW_REGISTERS=y
CONFIG_OL_RX_INDICATION_RECORD=y
CONFIG_TSOSEG_DEBUG=y
CONFIG_DP_TRACE=y
CONFIG_FEATURE_TSO=y
CONFIG_RX_OL=y
CONFIG_FEATURE_PKTLOG=y
CONFIG_WLAN_DEBUG_CRASH_INJECT=y
CONFIG_WLAN_DEBUGFS=y
CONFIG_WLAN_MWS_INFO_DEBUGFS=y
CONFIG_WLAN_FEATURE_MIB_STATS=y
CONFIG_PANIC_ON_BUG=y
CONFIG_WLAN_WARN_ON_ASSERT=y
CONFIG_WLAN_LOG_FATAL=y
CONFIG_WLAN_LOG_ERROR=y
CONFIG_WLAN_LOG_WARN=y
CONFIG_WLAN_LOG_INFO=y
CONFIG_WLAN_LOG_DEBUG=y
CONFIG_WLAN_LOG_ENTER=y
CONFIG_WLAN_LOG_EXIT=y
CONFIG_ATH_PERF_PWR_OFFLOAD=y
CONFIG_HIF_SNOC=y
CONFIG_QCOM_ESE=y
CONFIG_WLAN_OPEN_P2P_INTERFACE=y
CONFIG_WLAN_ENABLE_SOCIAL_CHANNELS_5G_ONLY=y
CONFIG_ATH_BUS_PM=y
CONFIG_SMMU_S1_UNMAP=y
CONFIG_PKTLOG_LEGACY=y
CONFIG_LITTLE_ENDIAN=y
CONFIG_QCA_WIFI_FTM=y
CONFIG_QCA_WIFI_FTM_NL80211=y
CONFIG_GTK_OFFLOAD=y
CONFIG_TARGET_RAMDUMP_AFTER_KERNEL_PANIC=y
CONFIG_FEATURE_STATS_EXT=y
CONFIG_WLAN_DFS_STATIC_MEM_ALLOC=y
CONFIG_FEATURE_HTC_CREDIT_HISTORY=y
CONFIG_TRACE_RECORD_FEATURE=y
CONFIG_WLAN_FEATURE_P2P_DEBUG=y
CONFIG_FEATURE_ROAM_DEBUG=y
CONFIG_WLAN_DFS_MASTER_ENABLE=y
CONFIG_ENABLE_MTRACE_LOG=y
CONFIG_WLAN_NUD_TRACKING=y
CONFIG_WLAN_WBUFF=y
CONFIG_DISABLE_CHANNEL_LIST=y
CONFIG_WLAN_BCN_RECV_FEATURE=y
CONFIG_LTE_COEX=y
CONFIG_TARGET_11D_SCAN=y
CONFIG_SAP_AVOID_ACS_FREQ_LIST=y
CONFIG_HOST_OPCLASS=y
CONFIG_WLAN_DYNAMIC_CVM=y
CONFIG_SAR_SAFETY_FEATURE=y
CONFIG_WIFI_POS_CONVERGED=y
CONFIG_WLAN_TWT_CONVERGED=y
CONFIG_CP_STATS=y
CONFIG_FEATURE_INTEROP_ISSUES_AP=y
CONFIG_FEATURE_WLAN_WAPI=y
CONFIG_FEATURE_FW_LOG_PARSING=y
CONFIG_PTT_SOCK_SVC_ENABLE=y
CONFIG_SOFTAP_CHANNEL_RANGE=y
CONFIG_FEATURE_WLAN_SCAN_PNO=y
CONFIG_WLAN_FEATURE_PACKET_FILTERING=y
CONFIG_WLAN_NS_OFFLOAD=y
CONFIG_FEATURE_WLAN_RA_FILTERING=y
CONFIG_FEATURE_WLAN_LPHB=y
CONFIG_QCA_SUPPORT_TX_THROTTLE=y
CONFIG_WMI_INTERFACE_EVENT_LOGGING=y
CONFIG_WLAN_FEATURE_LINK_LAYER_STATS=y
CONFIG_FEATURE_CLUB_LL_STATS_AND_GET_STATION=y
CONFIG_WMI_BCN_OFFLOAD=y
CONFIG_160MHZ_SUPPORT=y
CONFIG_REG_CLIENT=y
CONFIG_WLAN_PMO_ENABLE=y
CONFIG_CONVERGED_P2P_ENABLE=y
CONFIG_WLAN_POLICY_MGR_ENABLE=y
CONFIG_FOURTH_CONNECTION=y
CONFIG_HDD_INIT_WITH_RTNL_LOCK=y
CONFIG_WLAN_CONV_SPECTRAL_ENABLE=y
CONFIG_WLAN_SPECTRAL_ENABLE=y
CONFIG_WMI_CMD_STRINGS=y
CONFIG_FEATURE_MONITOR_MODE_SUPPORT=y
CONFIG_WLAN_FEATURE_TWT=y
CONFIG_FW_THERMAL_THROTTLE=y
CONFIG_WLAN_FEATURE_BIG_DATA_STATS=y
CONFIG_WLAN_FEATURE_IGMP_OFFLOAD=y
CONFIG_WLAN_FEATURE_GET_USABLE_CHAN_LIST=y
CONFIG_FEATURE_RADAR_HISTORY=y
CONFIG_FEATURE_RSSI_MONITOR=y
CONFIG_FEATURE_BSS_TRANSITION=y
CONFIG_FEATURE_STATION_INFO=y
CONFIG_FEATURE_TX_POWER=y
CONFIG_FEATURE_OTA_TEST=y
CONFIG_FEATURE_ACTIVE_TOS=y
CONFIG_FEATURE_SAR_LIMITS=y
CONFIG_FEATURE_CONCURRENCY_MATRIX=y
CONFIG_FEATURE_SAP_COND_CHAN_SWITCH=y
CONFIG_FEATURE_P2P_LISTEN_OFFLOAD=y
CONFIG_QCACLD_RX_DESC_MULTI_PAGE_ALLOC=y
CONFIG_WMI_ROAM_SUPPORT=y
CONFIG_WMI_CONCURRENCY_SUPPORT=y
CONFIG_WMI_STA_SUPPORT=y
CONFIG_FEATURE_HAL_RECORD_SUSPEND_WRITE=y
CONFIG_HIF_DEBUG=y
CONFIG_FEATURE_MEMDUMP_ENABLE=y
CONFIG_CONNECTIVITY_PKTLOG=y
CONFIG_PKTLOG_HAS_SPECIFIC_DATA=y
CONFIG_DESC_DUP_DETECT_DEBUG=y
CONFIG_FEATURE_OEM_DATA=y
CONFIG_WLAN_FW_OFFLOAD=y
CONFIG_WLAN_FEATURE_ELNA=y
CONFIG_WLAN_FEATURE_MDNS_OFFLOAD=y
CONFIG_WLAN_FEATURE_ICMP_OFFLOAD=y
CONFIG_WLAN_FEATURE_DP_BUS_BANDWIDTH=y
CONFIG_HANDLE_BC_EAP_TX_FRM=y
CONFIG_SAP_DHCP_FW_IND=y
CONFIG_ANI_LEVEL_REQUEST=y
CONFIG_DEBUG_RX_RING_BUFFER=y
CONFIG_RX_HASH_DEBUG=y
CONFIG_FEATURE_VDEV_OPS_WAKELOCK=y
CONFIG_WLAN_HANG_EVENT=y
CONFIG_WLAN_THERMAL_MULTI_CLIENT_SUPPORT=y
CONFIG_WLAN_DEBUG_LINK_VOTE=y
CONFIG_WLAN_FEATURE_CAL_FAILURE_TRIGGER=y
CONFIG_WLAN_FEATURE_DYNAMIC_MAC_ADDR_UPDATE=y
CONFIG_CHECKSUM_OFFLOAD=y
CONFIG_LINUX_QCMBR=y
CONFIG_QCA_CLD_WLAN=y
CONFIG_WLAN_CUSTOM_DSCP_UP_MAP=y
CONFIG_WLAN_FEATURE_SARV1_TO_SARV2=y
CONFIG_QCACLD_WLAN_CONNECTIVITY_DIAG_EVENT=y
CONFIG_WLAN_LOGGING_SOCK_SVC=y
CONFIG_WLAN_CTRL_NAME="wlan"
CONFIG_MULTI_IF_NAME="adrastea"
CONFIG_CNSS_ADRASTEA=y
CONFIG_ROME_IF="snoc"
CONFIG_HIF_LARGE_CE_RING_HISTORY=8192
CONFIG_WLAN_DEBUG_VERSION=y
CONFIG_HELIUMPLUS=y
CONFIG_64BIT_PADDR=y
CONFIG_FEATURE_TSO_DEBUG=y
CONFIG_WLAN_SYSFS_LOG_BUFFER=y
CONFIG_WLAN_SYSFS_DFSNOL=y
CONFIG_WLAN_SYSFS_WDS_MODE=y
CONFIG_WLAN_SYSFS_ROAM_TRIGGER_BITMAP=y
CONFIG_WLAN_SYSFS_RF_TEST_MODE=y
CONFIG_WLAN_PDEV_VDEV_SEND_MULTI_PARAM=y
CONFIG_FEATURE_WLAN_PRE_CAC=y
CONFIG_QCACLD_FEATURE_METERING=y
CONFIG_WLAN_VENDOR_HANDOFF_CONTROL=y
CONFIG_QCOM_LTE_COEX=y
CONFIG_WLAN_FEATURE_LPSS=y
CONFIG_WLAN_FASTPATH=y
CONFIG_FEATURE_ENABLE_CE_DP_IRQ_AFFINE=y
CONFIG_WLAN_DIAG_VERSION=y
CONFIG_WLAN_SEND_DSCP_UP_MAP_TO_FW=y
CONFIG_WLAN_WEXT_SUPPORT_ENABLE=y
CONFIG_FEATURE_DELAYED_PEER_OBJ_DESTROY=y
CONFIG_FEATURE_SET=y
CONFIG_FEATURE_DENYLIST_MGR=y
CONFIG_SUPPORT_11AX=y
CONFIG_ENABLE_DEBUG_ADDRESS_MARKING=y
CONFIG_WLAN_FEATURE_SAP_ACS_OPTIMIZE=y
CONFIG_WLAN_TRACE_HIDE_MAC_ADDRESS_DISABLE=y
CONFIG_QCACLD_WLAN_CONNECTIVITY_LOGGING=y
CONFIG_WLAN_DUMP_IN_PROGRESS=y
CONFIG_WLAN_DISABLE_EXPORT_SYMBOL=y
CONFIG_MPC_UT_FRAMEWORK=y
CONFIG_HTT_PADDR64=y
CONFIG_BUILD_DEBUG_VERSION=y
CONFIG_BUILD_DIAG_VERSION=y
CONFIG_MCL=y
CONFIG_FEATURE_BLACKLIST_MGR=y
CONFIG_ARCH_MSM=y
CONFIG_FEATURE_TSO_STATS=y
CONFIG_TSO_DEBUG_LOG_ENABLE=y
CONFIG_QDF_NBUF_HISTORY_SIZE=8192
CONFIG_PKT_LOG=y
CONFIG_AR900B=y
```

## configs/pitti_consolidate_adrastea_defconfig
```kconfig
CONFIG_ATH_DIAG_EXT_DIRECT=y
CONFIG_DESC_TIMESTAMP_DEBUG_INFO=y
CONFIG_DSC_DEBUG=y
CONFIG_DSC_TEST=y
CONFIG_FEATURE_UNIT_TEST_SUSPEND=y
CONFIG_HAL_DEBUG=y
CONFIG_LEAK_DETECTION=y
CONFIG_MAX_LOGS_PER_SEC=500
CONFIG_ENABLE_MAX_LOGS_PER_SEC=y
CONFIG_REGISTER_OP_DEBUG=y
CONFIG_SCHED_HISTORY_SIZE=256
CONFIG_TALLOC_DEBUG=y
CONFIG_UNIT_TEST=y
CONFIG_QDF_TEST=y
CONFIG_FEATURE_WLM_STATS=y
```

## configs/qca6750_defconfig
```kconfig
CONFIG_CNSS_QCA6750 := y
$(warning "### DBG CONFIG_CNSS_QCA6750")
include $(WLAN_ROOT)/configs/default_defconfig

#Enable Constrained Application Protocol feature
CONFIG_WLAN_FEATURE_COAP := y
```
