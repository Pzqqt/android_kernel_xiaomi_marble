## configs/qcn7605_defconfig
```kconfig
include $(WLAN_ROOT)/configs/genoa.pci.debug_defconfig

# Number of vdevs supported at one time, used for allocating memory
CONFIG_WLAN_MAX_VDEVS := 4
```

## configs/wcn7850_defconfig
```kconfig
CONFIG_CNSS_WCN7850 := y

include $(WLAN_ROOT)/configs/default_defconfig

#Enable 11BE EHT
CONFIG_WLAN_FEATURE_11BE := y

# Max Sta Vdev Config
CONFIG_CFG_MAX_STA_VDEVS := 4

#Enable 11BE MLO
CONFIG_WLAN_FEATURE_11BE_MLO := y

CONFIG_WLAN_FEATURE_DYNAMIC_MAC_ADDR_UPDATE := y
```

## configs/whunt_defconfig
```kconfig
#Enable 6 GHz Band
CONFIG_BAND_6GHZ := y

#Enable 11AX Feature
CONFIG_WLAN_FEATURE_11AX := y

include $(WLAN_ROOT)/configs/default_defconfig
```

## core/Kconfig
```kconfig
#
# RMNET MAP driver
#

menuconfig RMNET_CORE
	default m 
	select GRO_CELLS
	select RMNET_LA_PLATFORM
	---help---
	  If you select this, you will enable the RMNET module which is used
	  for handling data in the multiplexing and aggregation protocol (MAP)
	  format in the embedded data path. RMNET devices can be attached to
	  any IP mode physical device.

menuconfig RMNET_CTL
	default m
	---help---
	  Enable the RMNET CTL module which is used for handling QMAP commands
	  for flow control purposes.

config RMNET_LA_PLATFORM
	bool "Rmnet LA Platform Setting"
	depends on CONFIG_ARCH_LAHAINA
	default y
	---help---
	  Say Y here if you want rmnet_core to be able to include android
	  specific header file locations
```

## drivers/hwtracing/google/Kconfig
```kconfig
config CORESIGHT_PLACEHOLDER
	tristate "Coresight device placeholder driver"
	default y
	depends on !CORESIGHT
	help
	  For targets which do not use coresight, this option enables a placeholder
	  which probes coresight devices to turn down clocks to save power.

config CORESIGHT_AMBA_PLACEHOLDER
	tristate "Coresight primecell device placeholder driver"
	default y
	depends on !CORESIGHT
	help
	  For targets which do not use coresight, this option enables a placeholder
	  which probes coresight AMBA devices to turn down clocks to save power.
```

## drivers/input/touchscreen/goodix_9916r/Kconfig
```kconfig
#
# Goodix touchscreen driver configuration
#
menuconfig TOUCHSCREEN_GOODIX_BRL_9916
	tristate "Goodix berlin touchscreen"
	default n
	help
	  Say Y here if you have a Goodix berlin series touch controller
	  to your system.
	  If build module, say M.
	  If unsure, say N.

if TOUCHSCREEN_GOODIX_BRL_9916

config TOUCHSCREEN_GOODIX_BRL_9916_SPI
	bool "support SPI bus connection"
	default y
	help
		Say Y here if the touchscreen is connected via SPI bus.

config TOUCHSCREEN_GOODIX_BRL_9916_DEBUG
	bool "Debug"

endif
```

## drivers/misc/hwid/Kconfig
```kconfig
config MI_HARDWARE_ID
	tristate "Xiaomi hardware identification module"
	default n
	help
	  This adds support for mi hwid.
```

## drivers/staging/qcacld-3.0/Kconfig
```kconfig
comment "Qualcomm Atheros CLD WLAN module"

config QCA_CLD_WLAN

	tristate "Qualcomm Atheros CLD WLAN module"
	default n
	help
	Add support for the Qualcomm Atheros CLD WLAN module

if QCA_CLD_WLAN != n

config QCA_CLD_WLAN_PROFILE
	string "Configuration profile for Qualcomm Atheros CLD WLAN module"
	default "default"
	help
	  Specify which configuration profile to be used for building
	  this module.
	  Profiles are located at drivers/staging/qcacld-3.0/configs.


config CNSS_ADRASTEA
	bool "Enable CONFIG_CNSS_ADRASTEA"
	default n

menu "Optional Configs"

if CNSS_ADRASTEA

config MULTI_IF_NAME
	string "Enable CONFIG_MULTI_IF_NAME"
	default adrastea

endif
endmenu
endif # QCA_CLD_WLAN
```

## drivers/staging/qcacld-3.0/configs/parrot_gki_qca6750_defconfig
```kconfig
CONFIG_QCA_CLD_WLAN=y
CONFIG_160MHZ_SUPPORT=y
CONFIG_6G_SCAN_CHAN_SORT_ALGO=y
CONFIG_ADAPTIVE_11R=y
CONFIG_ANI_LEVEL_REQUEST=y
CONFIG_AR900B=y
CONFIG_ATH_11AC_TXCOMPACT=y
CONFIG_ATH_BUS_PM=y
CONFIG_ATH_PERF_PWR_OFFLOAD=y
CONFIG_BAND_6GHZ=y
CONFIG_BUILD_DEBUG_VERSION=y
CONFIG_BUILD_DIAG_VERSION=y
CONFIG_BUS_AUTO_SUSPEND=y
CONFIG_CHECKSUM_OFFLOAD=y
CONFIG_CNSS_GENL_MODULE=y
CONFIG_CNSS_UTILS_MODULE=y
CONFIG_CONNECTIVITY_PKTLOG=y
CONFIG_CONVERGED_P2P_ENABLE=y
CONFIG_CP_STATS=y
CONFIG_DDP_MON_RSSI_IN_DBM=y
CONFIG_DEBUG_RX_RING_BUFFER=y
CONFIG_WLAN_TRACE_HIDE_MAC_ADDRESS_DISABLE=y
CONFIG_DELIVERY_TO_STACK_STATUS_CHECK=y
CONFIG_DESC_DUP_DETECT_DEBUG=y
CONFIG_DIRECT_BUF_RX_ENABLE=y
CONFIG_DISABLE_CHANNEL_LIST=y
CONFIG_WLAN_BCN_RECV_FEATURE=y
CONFIG_DISABLE_EAPOL_INTRABSS_FWD=y
CONFIG_DP_HW_TX_DELAY_STATS_ENABLE=y
CONFIG_DP_INTR_POLL_BASED=y
CONFIG_DP_LEGACY_MODE_CSM_DEFAULT_DISABLE=1
CONFIG_DP_LFR=y
CONFIG_DP_MEM_PRE_ALLOC=y
CONFIG_DP_PKT_ADD_TIMESTAMP=y
CONFIG_DP_RX_BUFFER_POOL_ALLOC_THRES=5
CONFIG_DP_RX_BUFFER_POOL_SIZE=128
CONFIG_DP_RX_DROP_RAW_FRM=y
CONFIG_DP_RX_PKT_NO_PEER_DELIVER=y
CONFIG_DP_RX_SPECIAL_FRAME_NEED=y
CONFIG_DP_SWLM=y
CONFIG_DP_TRACE=y
CONFIG_DP_TXRX_SOC_ATTACH=y
CONFIG_DP_TX_TRACKING=y
CONFIG_DUP_RX_DESC_WAR=y
CONFIG_DYNAMIC_RX_AGGREGATION=y
CONFIG_ENABLE_HAL_REG_WR_HISTORY=y
CONFIG_ENABLE_HAL_SOC_STATS=y
CONFIG_ENABLE_MTRACE_LOG=y
CONFIG_FEATURE_ACTIVE_TOS=y
CONFIG_FEATURE_ALIGN_STATS_FROM_DP=y
CONFIG_FEATURE_AST=y
CONFIG_FEATURE_BECN_STATS=y
CONFIG_FEATURE_BLACKLIST_MGR=y
CONFIG_FEATURE_BSS_TRANSITION=y
CONFIG_FEATURE_CLUB_LL_STATS_AND_GET_STATION=y
CONFIG_FEATURE_CONCURRENCY_MATRIX=y
CONFIG_FEATURE_EPPING=y
CONFIG_FEATURE_FORCE_WAKE=y
CONFIG_FEATURE_FW_LOG_PARSING=y
CONFIG_FEATURE_GPIO_CFG=y
CONFIG_FEATURE_HAL_DELAYED_REG_WRITE=y
CONFIG_FEATURE_HTC_CREDIT_HISTORY=y
CONFIG_FEATURE_INTEROP_ISSUES_AP=y
CONFIG_FEATURE_MEMDUMP_ENABLE=y
CONFIG_FEATURE_MONITOR_MODE_SUPPORT=y
CONFIG_FEATURE_MSCS=y
CONFIG_FEATURE_NO_DBS_INTRABAND_MCC_SUPPORT=y
CONFIG_FEATURE_OEM_DATA=y
CONFIG_FEATURE_OTA_TEST=y
CONFIG_FEATURE_P2P_LISTEN_OFFLOAD=y
CONFIG_FEATURE_RADAR_HISTORY=y
CONFIG_FEATURE_ROAM_DEBUG=y
CONFIG_FEATURE_RSSI_MONITOR=y
CONFIG_FEATURE_SAP_COND_CHAN_SWITCH=y
CONFIG_FEATURE_SAR_LIMITS=y
CONFIG_FEATURE_STATION_INFO=y
CONFIG_FEATURE_STATS_EXT=y
CONFIG_FEATURE_STATS_EXT_V2=y
CONFIG_FEATURE_TSO=y
CONFIG_FEATURE_TSO_STATS=y
CONFIG_FEATURE_TX_POWER=y
CONFIG_FEATURE_VDEV_OPS_WAKELOCK=y
CONFIG_FEATURE_WLAN_LPHB=y
CONFIG_FEATURE_WLAN_RA_FILTERING=y
CONFIG_FEATURE_WLAN_SCAN_PNO=y
CONFIG_FEATURE_WLAN_WAPI=y
CONFIG_FIX_TXDMA_LIMITATION=y
CONFIG_FOURTH_CONNECTION=y
CONFIG_FW_THERMAL_THROTTLE=y
CONFIG_GTK_OFFLOAD=y
CONFIG_HAL_DISABLE_NON_BA_2K_JUMP_ERROR=y
CONFIG_HANDLE_BC_EAP_TX_FRM=y
CONFIG_HANDLE_RX_REROUTE_ERR=y
CONFIG_HASTINGS_BT_WAR=y
CONFIG_HDD_INIT_WITH_RTNL_LOCK=y
CONFIG_HIF_DEBUG=y
CONFIG_HIF_IPCI=y
CONFIG_HOST_OPCLASS=y
CONFIG_HOST_WAKEUP_OVER_QMI=y
CONFIG_HTT_PADDR64=y
CONFIG_ICNSS2_MODULE=y
CONFIG_IPA_SET_RESET_TX_DB_PA=y
CONFIG_LFR_SUBNET_DETECTION=y
CONFIG_LINUX_QCMBR=y
CONFIG_LITHIUM=y
CONFIG_LITTLE_ENDIAN=y
CONFIG_LL_DP_SUPPORT=y
CONFIG_LTE_COEX=y
CONFIG_MARK_ICMP_REQ_TO_FW=y
CONFIG_MAX_ALLOC_PAGE_SIZE=y
CONFIG_MCL=y
CONFIG_MON_ENABLE_DROP_FOR_MAC=y
CONFIG_MORE_TX_DESC=y
CONFIG_MULTI_CLIENT_LL_SUPPORT=y
CONFIG_NUM_SOC_PERF_CLUSTER=2
CONFIG_PANIC_ON_BUG=y
CONFIG_PCI_LINK_STATUS_SANITY=y
CONFIG_PEER_PROTECTED_ACCESS=y
CONFIG_PKTLOG_HAS_SPECIFIC_DATA=y
CONFIG_POWER_MANAGEMENT_OFFLOAD=y
CONFIG_PTT_SOCK_SVC_ENABLE=y
CONFIG_QCA6750_HEADERS_DEF=y
CONFIG_QCACLD_FEATURE_APF=y
CONFIG_QCACLD_FEATURE_FW_STATE=y
CONFIG_QCACLD_FEATURE_GREEN_AP=y
CONFIG_QCACLD_FEATURE_NAN=y
CONFIG_QCACLD_RX_DESC_MULTI_PAGE_ALLOC=y
CONFIG_QCACLD_WLAN_CONNECTIVITY_LOGGING=y
CONFIG_QCACLD_WLAN_LFR3=y
CONFIG_QCA_MONITOR_PKT_SUPPORT=y
CONFIG_QCA_SUPPORT_TX_THROTTLE=y
CONFIG_QCA_WIFI_FTM=y
CONFIG_QCA_WIFI_FTM_NL80211=y
CONFIG_QCA_WIFI_QCA6750=y
CONFIG_QCA_WIFI_QCA8074=y
CONFIG_QCA_WIFI_QCA8074_VP=y
CONFIG_QCOM_ESE=y
CONFIG_QCOM_LTE_COEX=y
CONFIG_QCOM_TDLS=y
CONFIG_QCOM_VOWIFI_11R=y
CONFIG_QMI_SUPPORT=y
CONFIG_REG_CLIENT=y
CONFIG_REO_DESC_DEFER_FREE=y
CONFIG_ROME_IF="ipci"
CONFIG_PLD_IPCI_ICNSS_FLAG=y
CONFIG_RXDMA_ERR_PKT_DROP=y
CONFIG_RX_DEFRAG_DO_NOT_REINJECT=y
CONFIG_RX_DESC_SANITY_WAR=y
CONFIG_RX_HASH_DEBUG=y
CONFIG_RX_OL=y
CONFIG_SAE_SINGLE_PMK=y
CONFIG_SAP_AVOID_ACS_FREQ_LIST=y
CONFIG_SAP_DHCP_FW_IND=y
CONFIG_SAR_SAFETY_FEATURE=y
CONFIG_SCALE_INCLUDES=y
CONFIG_SERIALIZE_QUEUE_SETUP=y
CONFIG_SHADOW_V2=y
CONFIG_SOFTAP_CHANNEL_RANGE=y
CONFIG_SUPPORT_11AX=y
CONFIG_SYSTEM_PM_CHECK=y
CONFIG_TARGET_11D_SCAN=y
CONFIG_TARGET_RAMDUMP_AFTER_KERNEL_PANIC=y
CONFIG_THERMAL_STATS_SUPPORT=y
CONFIG_TRACE_RECORD_FEATURE=y
CONFIG_TSO_DEBUG_LOG_ENABLE=y
CONFIG_TX_MULTIQ_PER_AC=y
CONFIG_TX_MULTI_TCL=y
CONFIG_TX_PER_PDEV_DESC_POOL=y
CONFIG_TX_TID_OVERRIDE=y
CONFIG_VERBOSE_DEBUG=y
CONFIG_WAPI_BIG_ENDIAN=y
CONFIG_WCNSS_MEM_PRE_ALLOC_MODULE=y
CONFIG_WDI3_IPA_OVER_GSI=y
CONFIG_PKT_LOG=y
CONFIG_FEATURE_PKTLOG_EN_NON_LEGACY=y
CONFIG_WDI_EVENT_ENABLE=y
CONFIG_WIFI_MONITOR_SUPPORT=y
CONFIG_WIFI_POS_CONVERGED=y
CONFIG_WLAN_BMISS=y
CONFIG_WLAN_CE_INTERRUPT_THRESHOLD_CONFIG=y
CONFIG_WLAN_CFR_ENABLE=y
CONFIG_WLAN_CLD_DEV_PM_QOS=y
CONFIG_WLAN_CLD_PM_QOS=y
CONFIG_WLAN_CONV_SPECTRAL_ENABLE=y
CONFIG_WLAN_CUSTOM_DSCP_UP_MAP=y
CONFIG_WLAN_DEBUGFS=y
CONFIG_WLAN_DEBUG_CRASH_INJECT=y
CONFIG_WLAN_DEBUG_LINK_VOTE=y
CONFIG_WLAN_DEBUG_VERSION=y
CONFIG_WLAN_DFS_MASTER_ENABLE=y
CONFIG_WLAN_DFS_STATIC_MEM_ALLOC=y
CONFIG_WLAN_DISABLE_EXPORT_SYMBOL=y
CONFIG_WLAN_DL_MODES=y
CONFIG_WLAN_DP_FEATURE_DEFERRED_REO_QDESC_DESTROY=y
CONFIG_WLAN_DP_PENDING_MEM_FLUSH=y
CONFIG_WLAN_DP_PER_RING_TYPE_CONFIG=y
CONFIG_WLAN_DUMP_IN_PROGRESS=y
CONFIG_WLAN_DYNAMIC_CVM=y
CONFIG_WLAN_ENABLE_SOCIAL_CHANNELS_5G_ONLY=y
CONFIG_WLAN_ENH_CFR_ENABLE=y
CONFIG_WLAN_FEATURE_11AX=y
CONFIG_WLAN_FEATURE_11W=y
CONFIG_WLAN_FEATURE_ACTION_OUI=y
CONFIG_WLAN_FEATURE_BIG_DATA_STATS=y
CONFIG_WLAN_FEATURE_CAL_FAILURE_TRIGGER=y
CONFIG_WLAN_FEATURE_DFS_OFFLOAD=y
CONFIG_WLAN_FEATURE_DISA=y
CONFIG_FEATURE_WLAN_MCC_TO_SCC_SWITCH=y
CONFIG_WMI_STA_SUPPORT=y
CONFIG_QCACLD_WLAN_CONNECTIVITY_DIAG_EVENT=y
CONFIG_WLAN_FEATURE_DP_BUS_BANDWIDTH=y
CONFIG_WLAN_FEATURE_DP_EVENT_HISTORY=y
CONFIG_RX_FISA=y
CONFIG_WLAN_FEATURE_DP_RX_THREADS=y
CONFIG_WLAN_FEATURE_DYNAMIC_MAC_ADDR_UPDATE=y
CONFIG_WLAN_FEATURE_ELNA=y
CONFIG_WLAN_FEATURE_FILS=y
CONFIG_WLAN_FEATURE_FIPS=y
CONFIG_WLAN_FEATURE_GET_USABLE_CHAN_LIST=y
CONFIG_WLAN_FEATURE_ICMP_OFFLOAD=y
CONFIG_WLAN_FEATURE_IGMP_OFFLOAD=y
CONFIG_WLAN_FEATURE_LINK_LAYER_STATS=y
CONFIG_WLAN_FEATURE_LPSS=y
CONFIG_WLAN_FEATURE_LRO_CTX_IN_CB=y
CONFIG_WLAN_FEATURE_MBSSID=y
CONFIG_WLAN_FEATURE_MDNS_OFFLOAD=y
CONFIG_WLAN_FEATURE_MEDIUM_ASSESS=y
CONFIG_WLAN_FEATURE_MIB_STATS=y
CONFIG_WLAN_FEATURE_P2P_DEBUG=y
CONFIG_WLAN_FEATURE_P2P_P2P_STA=y
CONFIG_WLAN_FEATURE_PACKET_FILTERING=y
CONFIG_WLAN_FEATURE_RX_BUFFER_POOL=y
CONFIG_WLAN_FEATURE_RX_SOFTIRQ_TIME_LIMIT=y
CONFIG_WLAN_FEATURE_SAE=y
CONFIG_WLAN_FEATURE_TWT=y
CONFIG_WLAN_FEATURE_WMI_DIAG_OVER_CE7=y
CONFIG_WLAN_FREQ_LIST=y
CONFIG_WLAN_FW_OFFLOAD=y
CONFIG_WLAN_GTX_BW_MASK=y
CONFIG_WLAN_HANG_EVENT=y
CONFIG_WLAN_LOGGING_SOCK_SVC=y
CONFIG_WLAN_LOG_DEBUG=y
CONFIG_WLAN_LOG_ENTER=y
CONFIG_WLAN_LOG_ERROR=y
CONFIG_WLAN_LOG_EXIT=y
CONFIG_WLAN_LOG_FATAL=y
CONFIG_WLAN_LOG_INFO=y
CONFIG_WLAN_LOG_WARN=y
CONFIG_WLAN_MWS_INFO_DEBUGFS=y
CONFIG_WLAN_NAPI=y
CONFIG_WLAN_NS_OFFLOAD=y
CONFIG_WLAN_NUD_TRACKING=y
CONFIG_WLAN_OFFLOAD_PACKETS=y
CONFIG_WLAN_OPEN_P2P_INTERFACE=y
CONFIG_WLAN_OPEN_SOURCE=y
CONFIG_WLAN_PMO_ENABLE=y
CONFIG_WLAN_POLICY_MGR_ENABLE=y
CONFIG_WLAN_POWER_DEBUG=y
CONFIG_WLAN_REASSOC=y
CONFIG_WLAN_SCAN_DISABLE=y
CONFIG_WLAN_SKIP_BAR_UPDATE=y
CONFIG_WLAN_SPECTRAL_ENABLE=y
CONFIG_WLAN_SUPPORT_DATA_STALL=y
CONFIG_WLAN_SYNC_TSF=y
CONFIG_WLAN_SYSFS=y
CONFIG_WLAN_SYSFS_CHANNEL=y
CONFIG_WLAN_SYSFS_CONNECT_INFO=y
CONFIG_WLAN_SYSFS_DCM=y
CONFIG_WLAN_SYSFS_DP_TRACE=y
CONFIG_WLAN_SYSFS_FW_MODE_CFG=y
CONFIG_WLAN_SYSFS_HE_BSS_COLOR=y
CONFIG_WLAN_SYSFS_MEM_STATS=y
CONFIG_WLAN_SYSFS_MONITOR_MODE_CHANNEL=y
CONFIG_WLAN_SYSFS_RADAR=y
CONFIG_WLAN_SYSFS_RTS_CTS=y
CONFIG_WLAN_SYSFS_SCAN_CFG=y
CONFIG_WLAN_SYSFS_STATS=y
CONFIG_WLAN_SYSFS_STA_INFO=y
CONFIG_WLAN_SYSFS_TDLS_PEERS=y
CONFIG_WLAN_SYSFS_TEMPERATURE=y
CONFIG_WLAN_SYSFS_TX_STBC=y
CONFIG_WLAN_SYSFS_WLAN_DBG=y
CONFIG_WLAN_THERMAL_CFG=y
CONFIG_WLAN_THERMAL_MULTI_CLIENT_SUPPORT=y
CONFIG_WLAN_TRACEPOINTS=y
CONFIG_WLAN_TWT_CONVERGED=y
CONFIG_WLAN_TXRX_FW_STATS=y
CONFIG_WLAN_TXRX_FW_ST_RST=y
CONFIG_WLAN_TXRX_STATS=y
CONFIG_WLAN_TX_FLOW_CONTROL_V2=y
CONFIG_WLAN_WARN_ON_ASSERT=y
CONFIG_WLAN_WBUFF=y
CONFIG_WLAN_WEXT_SUPPORT_ENABLE=y
CONFIG_WLAN_WOWL_ADD_PTRN=y
CONFIG_WLAN_WOWL_DEL_PTRN=y
CONFIG_WLAN_WOW_ITO=y
CONFIG_WMI_BCN_OFFLOAD=y
CONFIG_WMI_CMD_STRINGS=y
CONFIG_WMI_CONCURRENCY_SUPPORT=y
CONFIG_WMI_DBR_SUPPORT=y
CONFIG_WMI_INTERFACE_EVENT_LOGGING=y
CONFIG_WMI_ROAM_SUPPORT=y
CONFIG_WMI_SEND_RECV_QMI=y
CONFIG_WLAN_CTRL_NAME="wlan"
CONFIG_MULTI_IF_NAME="qca6750"
CONFIG_CNSS_QCA6750=y
CONFIG_BUILD_TAG=y
CONFIG_DP_RX_DESC_COOKIE_INVALIDATE=y
```

## drivers/staging/qcacld-3.0/configs/qca6490_defconfig
```kconfig
CONFIG_CNSS_QCA6490 := y
include $(WLAN_ROOT)/configs/default_defconfig

#Enable Constrained Application Protocol feature
CONFIG_WLAN_FEATURE_COAP := y
```

## drivers/staging/qcacld-3.0/configs/qca6750_defconfig
```kconfig
CONFIG_CNSS_QCA6750 := y
$(warning "### DBG CONFIG_CNSS_QCA6750")
include $(WLAN_ROOT)/configs/default_defconfig

#Enable Constrained Application Protocol feature
CONFIG_WLAN_FEATURE_COAP := y
CONFIG_FEATURE_WLAN_CH_AVOID_EXT := y
```
